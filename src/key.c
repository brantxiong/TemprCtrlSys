/***********************************************************************/
/*                                                                     */
/*  key.c:  按键处理模块			                     			   */
/*                                                                     */
/***********************************************************************/
#include "..\\head\\common.h"
#include "..\\head\\key.h"
#include "..\\head\\serial.h"
#include "..\\head\\temperature.h"
#include "..\\head\\time.h"

char flash = 0;


/***************************************************************
* 功能：使能按键中断
***************************************************************/
void KeyInit()
{
	// S1配置为输入	P0.5
	GP0DAT &= ~(1<<29);

	// S2配置为输入	P0.6
	GP0DAT &= ~(1<<30);

	// S3配置为输入	P1.2
	GP1DAT &= ~(1<<26);


	// S4配置为输入	P1.3
	GP1DAT &= ~(1<<27);

	IRQEN |= (1<<22);

}

/***************************************************************
* 功能：检测按下哪个键
***************************************************************/
void CheckKey()
{	
	//S1 按下
	if( (GP0DAT & (1<<5) ) == (1<<5) )
	{
		SwitchKey();
	}
	//S2 按下
	if( (GP0DAT & (1<<6) ) == (1<<6) )
	{
		AddKey();
	}
	//S3 按下
	if( (GP1DAT & (1<<2) ) == (1<<2) )
	{
		DecKey();
	}
	//S4 按下
	if( (GP1DAT & (1<<3) ) == (1<<3) )
	{
		AckKey();
	}
	DelayMs(100);
}

/***************************************************************
* 功能：按下切换键
***************************************************************/
void SwitchKey()
{
	stage = 1;
	flash ++;
	if(flash == 3)
	{
		flash = 0;
	} 		
	
}

/***************************************************************
* 功能：增加键
***************************************************************/
void AddKey()
{
	if(flash == 1)
	{
		set_tmp += 5;
		if(set_tmp >= 100)
		{
			set_tmp = 10;
		}
	}
	if(flash == 2)
	{
		set_min += 5;
		if(set_min >= 100)
		{
			set_min = 0;
		}
	}
}

/***************************************************************
* 功能：减少键
***************************************************************/
void DecKey()
{
	if(flash == 1)
	{
		set_tmp --;
		if(set_tmp == 0)
		{
			set_tmp = 100;
		}
	}
	if(flash == 2)
	{
		set_min --;
		if(set_min == 0)
		{
			set_min = 99;
		}
	}
}

/***************************************************************
* 功能：确认键
***************************************************************/
void AckKey()
{
	remain_sec = 59;
	stage = 2;
	flash = 0;
}



