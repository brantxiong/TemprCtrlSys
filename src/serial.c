/***********************************************************************/
/*                                                                     */
/*  serial.c:  串口控制模块                        					   */
/*                                                                     */
/***********************************************************************/


#include "..\\head\\common.h"
#include "..\\head\\serial.h"

// 定义回车符
#define CR     0x0D

/***************************************************************
* 功能：初始化串口
***************************************************************/
void SerialInit(void)
{	
	// Setup tx & rx pins on P1.0 and P1.1
	GP1CON = 0x011;
	
	// Start setting up UART at 9600bps
	COMCON0 = 0x080;				// Setting DLAB
	COMDIV0 = 0x088;				// Setting DIV0 and DIV1 to DL calculated
	COMDIV1 = 0x000;
	COMCON0 = 0x007;				// Clearing DLAB
}


/***************************************************************
* 功能：向串口发送一个字符
***************************************************************/
int PutChar(int ch)  
{                 

	if (ch == '\n')  
	{
    	while(!(0x020==(COMSTA0 & 0x020)))
    	{}
		COMTX = CR;						
	}
    while(!(0x020==(COMSTA0 & 0x020)))
    {} 
 	return (COMTX = ch);
}

/***************************************************************
* 功能：从串口读取一个字符
***************************************************************/
int GetChar (void) 
{                    

   	while(!(0x01==(COMSTA0 & 0x01)))
   	{}
  	return (COMRX);
}

/***************************************************************
* 功能：向串口写一串字符串
***************************************************************/
int Write (char * ptr) 
{
  int i,len;
  len = strlen(ptr); 
  for (i = 0; i < len; i++) 
  	PutChar (*ptr++);
  return len;
}

